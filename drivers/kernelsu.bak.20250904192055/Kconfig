## drivers/misc/mediatek/perfmgr/Kconfig
```kconfig
config MTK_PERFMGR
    bool "MTK Performance Manager"
    depends on CPU_FREQ
    default y
    help
      MediaTek performance manager used by FPSGO, EARA and XGF.

config MTK_PERFMGR_NET
    bool "MTK PerfMgr Net Hooks"
    default y
```

## drivers/misc/mediatek/performance/eara_thermal/Kconfig
```kconfig
config MTK_EARA_THERMAL
    bool "Enable EARA Thermal"
    depends on MTK_EARA
    default y
```

## drivers/misc/mediatek/performance/fpsgo_v3/Kconfig
```kconfig
#
# Copyright (C) 2020 MediaTek Inc.
#
# This program is free software: you can redistribute it and/or modify
# it under the terms of the GNU General Public License version 2 as
# published by the Free Software Foundation.
#

# CORREÇÃO: Mudado de 'bool' para 'tristate' para permitir compilação como módulo (.ko)
config MTK_FPSGO_V3
	tristate "Support FPSGO_V3 framework"
	default y
	help
	  Support FPSGO_V3 framework for most FPS performance and
	  low power balance. As a perquisite to ensure FPS performance,
	  FPSGO_V3 persuades lowest power consumption for better DoU
	  endurance and gaming experience.
	  FPSGO_V3 include AI performance and low power.
	  If you are not sure about this, set n.
```

## drivers/misc/mediatek/performance/fpsgo_v3/eara_job/Kconfig
```kconfig
config MTK_EARA
    bool "Enable EARA (Energy Aware Resource Allocation)"
    depends on MTK_FPSGO_V3
    default y
```

## drivers/misc/mediatek/pnpmgr/Kconfig
```kconfig
config PNPMGR
    bool "MediaTek pnpmgr (performance manager) compatibility/port"
    depends on MTK_PERFMGR_TOUCH_BOOST
    help
      PNPMGR provides kernel-side hooks and sysfs for MediaTek's power/perf
      userspace (pnpmgr). It creates /sys/pnpmgr/<...> and exports functions
      such as pnpmgr_set_boost(). Enable for fpsgo/perfmgr compatibility.
```
